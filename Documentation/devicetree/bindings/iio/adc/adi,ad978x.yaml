## Documentation/devicetree/bindings/iio/adc/adi,ad978x.yaml
```yaml
# SPDX-License-Identifier: (GPL-2.0-only OR BSD-2-Clause)
# Copyright 2022 Analog Devices Inc.
%YAML 1.2
---
$id: http://devicetree.org/schemas/bindings/iio/adc/adi,ad978x.yaml#
$schema: http://devicetree.org/meta-schemas/core.yaml#

title: Analog Devices AD978x DAC family device driver

maintainers:
  - Sergiu Cuciurean <sergiu.cuciurean@analog.com>

description: |
  The AD9780/AD9781/AD9783 include pin-compatible, high
  dynamic range, dual digital-to-analog converters (DACs) with
  12-/14-/16-bit resolutions, and sample rates of up to 500 MSPS.

notes: |
  This device depends on the AXI-ADC IP core. Please refer to:

  http://devicetree.org/schemas/iio/adc/adi,axi-adc.yaml
  https://wiki.analog.com/resources/fpga/docs/axi_adc_ip

properties:
  compatible:
    enum:
      - adi,ad9780
      - adi,ad9781
      - adi,ad9783

  reg:
    category: required
    description:
      SPI chip select number for the device
    maxItems: 1

  spi-max-frequency:
    category: required
    description: Maximum SPI clocking speed of device in Hz

  clocks:
    category: required
    description:
      DAC sampling clock input

  clocks-names:
    category: required
    description:
      DAC sampling clock target name

examples:
  dts: |
    &spi0 {
      ad9783_spi: adc@0 {
        compatible = "adi,ad9783";
        reg = <0>;
        spi-max-freequency = <10000000>;
        clocks = <&ad9783_clk>;
        clock-names = "dac_clk";
      };
    };

    &abma_pl {
      axi_ad9783_core: axi_dds@94204000 {
        compatible = "adi,axi-ad978x-1.0";
        reg = <0x94204000 0x4000>;
        dmas = <&tx_dma 0>;
        dma-names = "tx";
        spibus-connected = <&ad9783_spi>;
      };
    };
```
